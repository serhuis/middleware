## _mw_main/Kconfig.projbuild
```kconfig
menu "MiddleWare"

	config ZHAGA_NVS_ENABLE
	bool "Enable  Zhaga NV memory"
	default false
rsource "../nv_memory/Kconfig"
        
    config ENABLE_FAT_FS
    bool "Enable FAT filesystem"
    default true
    help
        Enable filesystem to store loaded files (firmwares, etc...)
rsource "../storage/Kconfig"

    config ENABLE_BLE
    bool "Enable BLE"
    default true
    help
        Enable BLE functionality (GATT based)
rsource "../ble/Kconfig"

    config ZHAGA_CONNECT_WIFI
    bool "connect using WiFi interface"
    default y
    help
        Protocol examples can use Wi-Fi and/or Ethernet to connect to the network.
        Choose this option to connect with WiFi
rsource "../wifi/Kconfig"

    config TCP_SOCKET
    bool   "Enable TCP socket"
    default true
    help
        Enable TCP socket 
rsource "../tcp_server/Kconfig"

    config ENABLE_MQTT_CLIENT
    bool "Enable MQTT"
    default false
    help
        Enable MQTT client service
rsource "../mqtt_zhaga/Kconfig"
endmenu
```

## components/components_main/Kconfig.projbuild
```kconfig
menu "MiddleWare"
    rsource "../drvUart/Mconfig"
    rsource "../drvGpio/Mconfig"
    rsource "../nv_memory/Mconfig"
    rsource "../storage/Mconfig"
    rsource "../ble/Mconfig"
    rsource "../wifi/Mconfig"
    rsource "../mqtt_zhaga/Mconfig"
    rsource "../tcp_server/Mconfig"
    rsource "../mediator/Mconfig"
endmenu
```

## mqtt_zhaga/Kconfig
```kconfig
if ENABLE_MQTT_CLIENT
menu "Zhaga MQTT"
    config BROKER_URL
        string "Broker URL"
        default "mqtt://mqtt.eclipseprojects.io"
        help
            URL of the broker to connect to
    config BROCKER_HOST_IP
        string "Host ip"
        default "192.168.0.111" if BROKER_URL = ""
        help
            Host IP of the broker to connect to
    config MQTT_USER_NAME
        string "User name"
        default "zhaga"
        help 
            Username to connect to brocker
    config MQTT_PASSWORD
        string "Password"
        default "123"
        help    
            Password to connect to brocker
endmenu
endif
```

## nv_memory/Kconfig
```kconfig
if  ZHAGA_NVS_ENABLE
menu "Zhaga NV memory"

   config NVS_STORAGE_NAME
   string "NV partition name"
   default "ZhagaNVS"
endmenu
endif
```

## storage/Kconfig
```kconfig
if ENABLE_FAT_FS
menu "Zhaga SPIFS"
	config SPIFS_MOUNT_POINT
		string "Mount point for SPIFS filesystem"
		default "/storage"
endmenu
endif
```
